## package/dotnet/Config.in
```kconfig
config BR2_PACKAGE_DOTNET
    bool "dotnet"
    help
      Installs .NET runtime for the selected architecture.
```

## package/inputwait/Config.in
```kconfig
config BR2_PACKAGE_INPUTWAIT
    bool "inputwait"
    help
      Allows the user to test whether an event device emits a keypress over a specified timeout period.
```

## package/lua-evdev/Config.in
```kconfig
config BR2_PACKAGE_LUA_EVDEV
	bool "lua-evdev"
	select BR2_PACKAGE_LIBEVDEV
  help
    A Lua 5.2+ module for interacting with input devices on Linux.
```
